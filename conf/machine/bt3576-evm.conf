## conf/machine/bt3576-evm.conf
```bitbake
#@TYPE: Machine
#@NAME: BT3576-EVM-V1.0

include conf/machine/include/bt3576-evm-extlinux-config.inc
require conf/machine/include/rk3576.inc

MACHINE_FEATURES += "wifi pcmcia alsa bluetooth usbhost"

KERNEL_DEVICETREE = " \
    rockchip/bt3576-evm-b.dtb \
"

UBOOT_MACHINE = "rk3576_defconfig"
RK_UBOOT_SPL = "1"
KBUILD_DEFCONFIG = "bt3576_evm_b_defconfig"

MACHINE_EXTRA_RRECOMMENDS:append = " \
    drm-cursor \
    udev-conf-rockchip \
    gstreamer1.0-rockchip \
    rockchip-alsa-config \
    brcm-patchram-plus \
"

IMAGE_BOOT_FILES ?= " \
    boot.img \
    extlinux.conf;extlinux/extlinux.conf \
"

WKS_FILE_DEPENDS ?= " \
    u-boot-rockchip \
    smart-image-userfs \
"

KERNEL_IMAGETYPES:append = " fitImage"
IMAGE_FSTYPES:append = " ext4 squashfs"

HW_VERSION = "1.0"
IMAGE_VERSION = "1.0"
FACTORY_IMAGE = "smart-image-standard"
```

## conf/machine/include/bt3576-evm-extlinux-config.inc
```bitbake
UBOOT_EXTLINUX = "1"

# Define extlinux labels
UBOOT_EXTLINUX_LABELS = " \
    bt3576-evm \
"
UBOOT_EXTLINUX_DEFAULT_LABEL = "bt3576-evm"

# Define extlinux timeout
UBOOT_EXTLINUX_TIMEOUT = "20"

UBOOT_EXTLINUX_MENU_DESCRIPTION:bt3576-evm = "bt3576-evm"
UBOOT_EXTLINUX_KERNEL_IMAGE:bt3576-evm = "/boot.img"

# Define additional kernel arguments
UBOOT_EXTLINUX_ROOT:bt3576-evm = "LABEL=${LABEL} root=${bootroot}"
UBOOT_EXTLINUX_KERNEL_ARGS:bt3576-evm = "quiet rootwait rw"
```

## conf/machine/include/machine-extlinux-config.inc
```bitbake
UBOOT_EXTLINUX = "1"

# Define extlinux labels
UBOOT_EXTLINUX_LABELS = " \
    rk3566-tspi \
"
UBOOT_EXTLINUX_DEFAULT_LABEL = "rk3566-tspi"

# Define extlinux timeout
UBOOT_EXTLINUX_TIMEOUT = "20"

UBOOT_EXTLINUX_MENU_DESCRIPTION:rk3566-tspi = "rk3566-tspi"
UBOOT_EXTLINUX_KERNEL_IMAGE:rk3566-tspi = "/${KERNEL_IMAGETYPE}"
UBOOT_EXTLINUX_FDT:rk3566-tspi = "/rk3566-tspi.dtb"
UBOOT_EXTLINUX_INITRD:rk3566-tspi = "/initrd.img"

# Define additional kernel arguments
UBOOT_EXTLINUX_ROOT:rk3566-tspi = "LABEL=${LABEL} root=${rootparm}"
UBOOT_EXTLINUX_KERNEL_ARGS:rk3566-tspi = "quiet rootwait earlycon=${earlycon}"
```

## conf/machine/include/rk356x.inc
```bitbake
# Copyright (c) 2020, Rockchip Electronics Co., Ltd
# Released under the MIT license (see COPYING.MIT for the terms)

require conf/machine/include/rockchip-arm64-common.inc

SOC_FAMILY := "rk3568"

PREFERRED_VERSION_linux-rockchip := "5.10%"
LINUXLIBCVERSION := "5.10-custom%"
OLDEST_KERNEL := "5.10"

MALI_GPU := "bifrost-g52"
MALI_VERSION := "g2p0"

RK_ISP_VERSION := "2.1"

TFA_PLATFORM = "rk3568"
TFA_BUILD_TARGET = "bl31"
RK_CONSOLE_BAUD ?= "1500000"

UBOOT_SUFFIX ?= "itb"
UBOOT_ENTRYPOINT ?= "0x06000000"

FIREFLY_SDK_BRANCH = "rk3588/firefly"
FIREFLY_SDK_VERSION = "rk3588/linux_release_v1.1.1e"
```

## conf/machine/include/ym-sbc-rk3588-extlinux-config.inc
```bitbake
UBOOT_EXTLINUX = "1"

# Define extlinux labels
UBOOT_EXTLINUX_LABELS = " \
    ym-sbc-rk3588 \
"
UBOOT_EXTLINUX_DEFAULT_LABEL = "ym-sbc-rk3588"

# Define extlinux timeout
UBOOT_EXTLINUX_TIMEOUT = "20"

UBOOT_EXTLINUX_MENU_DESCRIPTION:ym-sbc-rk3588 = "ym-sbc-rk3588"
UBOOT_EXTLINUX_KERNEL_IMAGE:ym-sbc-rk3588 = "/boot.img"

# Define additional kernel arguments
UBOOT_EXTLINUX_ROOT:ym-sbc-rk3588 = "LABEL=${LABEL} root=${bootroot}"
UBOOT_EXTLINUX_KERNEL_ARGS:ym-sbc-rk3588 = "quiet rootwait rw"
```

## conf/machine/ym-sbc-rk3588.conf
```bitbake
#@TYPE: Machine
#@NAME: YM-RK3588

include conf/machine/include/ym-sbc-rk3588-extlinux-config.inc
require conf/machine/include/rk3588.inc

MACHINE_FEATURES += "wifi pcmcia alsa bluetooth usbhost"

KERNEL_DEVICETREE = " \
    rockchip/ym-sbc-rk3588.dtb \
"

UBOOT_MACHINE = "rk3588_defconfig"
KBUILD_DEFCONFIG = "ym_sbc_rk3588_defconfig"

RK_WIFIBT_RRECOMMENDS = " \
    rkwifibt-firmware-ap6256-wifi \
    rkwifibt-firmware-ap6256-bt \
    brcm-tools \
"

MACHINE_EXTRA_RRECOMMENDS:append = " \
    drm-cursor \
    udev-conf-rockchip \
    gstreamer1.0-rockchip \
    rockchip-alsa-config \
    brcm-patchram-plus \
    rockchip-rkaiq-server \
    rockchip-rkaiq-iqfiles \
"

IMAGE_BOOT_FILES ?= " \
    ${KERNEL_IMAGETYPE} \
    ym-sbc-rk3588.dtb \
    extlinux.conf;extlinux/extlinux.conf \
"

WKS_FILE_DEPENDS ?= " \
    u-boot-rockchip \
    smart-image-userfs \
"

KERNEL_IMAGETYPES:append = " fitImage"
IMAGE_FSTYPES:append = " ext4 squashfs"

HW_VERSION = "1.0"
IMAGE_VERSION = "6.0"
FACTORY_IMAGE = "smart-image-standard"
```
